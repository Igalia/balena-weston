## balena-weston/conf/layer.conf
```bitbake
BBPATH .= ":${LAYERDIR}"

BBFILES += "${LAYERDIR}/recipes-*/*/*.bb \
            ${LAYERDIR}/recipes-*/*/*.bbappend"

BBFILE_COLLECTIONS += "balena-weston"
BBFILE_PATTERN_balena-weston := "^${LAYERDIR}/"
BBFILE_PRIORITY_balena-weston = "99"

LAYERSERIES_COMPAT_balena-weston = "hardknott"
```

## yocto/conf/layer.conf
```bitbake
BBPATH .= ":${LAYERDIR}"

BBFILES += "${LAYERDIR}/recipes-*/*/*.bb \
            ${LAYERDIR}/recipes-*/*/*.bbappend"

BBFILE_COLLECTIONS += "weston"
BBFILE_PATTERN_weston := "^${LAYERDIR}/"
BBFILE_PRIORITY_weston = "99"

LAYERSERIES_COMPAT_weston = "langdale"
```
